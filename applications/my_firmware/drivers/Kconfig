## west.yml
```yaml
manifest:
  remotes:
    - name: ncs
      url-base: https://github.com/nrfconnect
    - name: me
      url-base: https://github.com/jeremyherbert

  projects:
    - name: nrf
      repo-path: sdk-nrf
      remote: ncs
      revision: v2.0.2
      import: true

    - name: zephyr-my-lib
      revision: 95d239aa5b07e19c113a27f9dcafc3b9b66283fe
      path: modules/lib/my-lib
      remote: me

  self:
    path: zephyr-kconfig-issue-manifest-repo
```
