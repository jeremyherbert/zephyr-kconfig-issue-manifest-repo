## CMakeLists.txt
```
cmake_minimum_required(VERSION 3.13.1)

set(BOARD nrf5340dk_nrf5340_cpuapp)

set(DTC_OVERLAY_FILE
	my_driver.overlay
)

# the following line actually sets up the zephyr build system
find_package(Zephyr REQUIRED HINTS $ENV{ZEPHYR_BASE})

# set the project name and version
project(my_test_firmware LANGUAGES C VERSION 1.0.0)

include(${CMAKE_CURRENT_LIST_DIR}/drivers/my_driver/CMakeLists.txt)

# include directories
target_include_directories(app PRIVATE
    src/rpc_api_server
    src
)

# source files
target_sources(app PRIVATE
	src/main.c
)
```

## Kconfig
```
menu "Zephyr"
source "Kconfig.zephyr"
endmenu

module = APP
module-str = APP
source "subsys/logging/Kconfig.template.log_config"

rsource "drivers/Kconfig"
```

## prj.conf
```kconfig
CONFIG_MY_DRIVER=y
CONFIG_MY_LIB=y

CONFIG_LOG=y
```

## my_driver.overlay
```dts
/ {
    my_driver_0: generic_my_driver_0 {
        compatible = "generic,my-driver";
    };
};
```

## src/main.c
```c
#include <zephyr.h>
#include <device.h>
#include <sys/printk.h>
#include <logging/log.h>

LOG_MODULE_REGISTER(MAIN, LOG_LEVEL_INF);

void main(void)
{
	const struct device *dev_mine = DEVICE_DT_GET(DT_NODELABEL(my_driver_0));

	if (!device_is_ready(dev_mine)) {
		LOG_ERR("My device is not ready!");
	}

	while (true) {
		printk("hello!");
		k_sleep(K_MSEC(500));
	}
}
```
